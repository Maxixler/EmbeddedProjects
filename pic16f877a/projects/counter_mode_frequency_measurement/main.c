/**
 * @file main.c
 * @brief Frequency Measurement Using Counter Mode (Timer1) for PIC16F877A
 * @details This project demonstrates how to measure frequency using Timer1 in counter mode.
 *          The external signal to be measured is applied to the T1CKI pin (RC0).
 *          Timer1 counts the incoming pulses, and we measure the count over a fixed period
 *          (e.g., 1 second) using Timer0 interrupt. The count value directly gives the
 *          frequency in Hz.
 *
 *          Formula from PROJECTS.md:
 *          TMRx_reg_degeri = Timer_max - (Gecikme * Fosc) / (Prescale * 4)
 *          For frequency measurement, we don't use this formula directly in the same way.
 *          Instead:
 *          1. Configure Timer1 as counter (not timer) to count external pulses on T1CKI pin
 *          2. Use Timer0 to generate a precise 1-second interval
 *          3. After 1 second, read Timer1 value - this is the frequency in Hz
 *
 *          Steps:
 *          - Timer1: Operate in counter mode, counting pulses on RC0/T1CKI pin
 *          - Timer0: Configured to overflow every 1ms, used to count 1000ms = 1s
 *          - After 1 second, Timer1 value = frequency of signal on T1CKI
 *          - Reset Timer1 and repeat
 *
 * @author Generated by Claude
 * @date 2026-06-07
 */

#include <pic16f877a.h>

// Configuration bits
#pragma config FOSC = HS        // High-speed Oscillator
#pragma config WDTE = OFF       // Watchdog Timer disabled
#pragma config PWRTE = OFF      // Power-up Timer disabled
#pragma config BOREN = OFF      // Brown-out Reset disabled
#pragma config LVP = OFF        // Low-voltage Programming disabled
#pragma config CPD = OFF        // Data EEPROM Memory Code Protection off
#pragma config WRT = OFF        // Flash Program Memory Write Protection off
#pragma config CP = OFF         // Flash Program Memory Code Protection off

#define _XTAL_FREQ 8000000     // Define oscillator frequency for delay macros

// Function to initialize Timer1 as counter
void Timer1_Counter_Init(void) {
    // Configure RC0/T1CKI pin as input (for external signal)
    TRISC0 = 1;                // RC0 as input

    // Configure Timer1 as counter
    T1CONbits.TMR1CS = 1;      // Timer1 Clock Select = external clock on T1CKI pin
    T1CONbits.T1SYNC = 0;      // Do not synchronize external clock input
    T1CONbits.T1CKPS0 = 0;     // Prescaler 1:1
    T1CONbits.T1CKPS1 = 0;
    T1CONbits.TMR1ON = 1;      // Enable Timer1

    // Clear Timer1 register
    TMR1H = 0;
    TMR1L = 0;
}

// Function to initialize Timer0 for 1ms interrupts
void Timer0_Init(void) {
    // We'll use Timer0 to create a 1ms time base
    OPTION_REGbits.T0CS = 0;   // Timer0 Clock Select = internal instruction cycle clock (Fosc/4)
    OPTION_REGbits.PSA = 0;    // Prescaler is assigned to Timer0
    // Set prescaler to 1:64 (PS2:PS0 = 010) for 1ms increments with 8MHz osc
    // With Fosc=8MHz, Tosc=0.25us, Fosc/4 = 1us
    // With prescaler=64, Timer0 increment period = 64 * 1us = 64us
    // To get 1ms, we need 1000us / 64us = 15.625 increments
    OPTION_REGbits.PS2 = 0;
    OPTION_REGbits.PS1 = 1;
    OPTION_REGbits.PS0 = 0;

    // Initial value for ~1ms period
    TMR0 = 256 - 16; // 240 -> gives us about 16 ticks * 64us = 1024us ~ 1ms
    // Actually, let's calculate more precisely:
    // We want Timer0 to overflow every 1ms
    // Overflow period = (256 - TMR0) * Tosc * 4 * prescaler
    // 1ms = (256 - TMR0) * 1us * 64
    // 1000us = (256 - TMR0) * 64us
    // 1000/64 = 256 - TMR0
    // 15.625 = 256 - TMR0
    // TMR0 = 256 - 15.625 = 240.375 -> 240
    TMR0 = 240;

    // Enable Timer0 interrupt
    INTCONbits.T0IE = 1;       // Enable Timer0 interrupt
}

// Global variables for timekeeping
volatile unsigned int ms_counter = 0;
volatile unsigned int second_flag = 0;

// Main function
void main() {
    unsigned int frequency = 0;

    // Configure I/O
    TRISC0 = 1;                // RC0/T1CKI as input (external signal)
    TRISB = 0x00;              // PORTB as output for displaying frequency (optional)
    PORTB = 0x00;

    // Initialize modules
    Timer1_Counter_Init();
    Timer0_Init();

    // Enable global and peripheral interrupts
    INTCONbits.PEIE = 1;       // Enable peripheral interrupts
    INTCONbits.GIE = 1;        // Enable global interrupts

    while(1) {
        // Check if 1 second has elapsed
        if (second_flag) {
            second_flag = 0;   // Reset flag

            // Read Timer1 value (frequency in Hz)
            frequency = (TMR1H << 8) | TMR1L;

            // Optional: Display frequency on PORTB (if connected to LEDs)
            // For demonstration, we'll show lower 8 bits on PORTB
            PORTB = (unsigned char)(frequency & 0xFF);

            // Reset Timer1 for next measurement
            TMR1H = 0;
            TMR1L = 0;
        }

        // Main loop can do other tasks here
        // For example, send frequency via UART, process it, etc.
    }
}

/**
 * @brief Timer0 Interrupt Service Routine
 * @details This ISR increments a millisecond counter and sets a flag
 *          when 1000ms (1 second) has elapsed.
 */
void interrupt ISR(void) {
    if (INTCONbits.T0IF) {     // Check if Timer0 interrupt flag is set
        ms_counter++;          // Increment millisecond counter

        // Reload Timer0 for next 1ms interval
        TMR0 = 240;            // Reload value for ~1ms

        // Check if 1 second has passed
        if (ms_counter >= 1000) {
            ms_counter = 0;    // Reset millisecond counter
            second_flag = 1;   // Set flag indicating 1 second elapsed
        }

        INTCONbits.T0IF = 0;   // Clear Timer0 interrupt flag
    }
}